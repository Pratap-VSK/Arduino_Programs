// QUESTION: Write a program to print "Hello World" on the LCD and Show time in second since the arduino was start/..

#include<LiquidCrystal.h>
LiquidCrystal lcd(12, 11, 6, 5, 4, 3);

void setup(){
    lcd.begin(16,2);
    lcd.print();
}

void loop(){
    lcd.setCursor(0, 1)
    lcd.print("Time= ");
    lcd.print(millis()/100);
    lcd.print("sec");
}





// QUESTION: WAP to control a relay using a button/..

int relaypin = 6;
int btnpin = 4;

void setup(){
    pinMode(relaypin, OUTPUT);
    pinMode(btnpin, INPUT);
}

void loop(){
    int state=digitalRead(btnpin);
    if(state == HIGH){
        digitalWrite(relaypin, HIGH);
    }
    else{
        digitalWrite(relaypin, LOW);
    }
    delay(500);
}




// QUESTION: Write a program to blink default light emmiting diod (LED) an arduino board with the delay of 2 second/..

int ledpin = 12;

void setup(){
    pinMode(ledpin, OUTPUT);
}

void loop(){
    digitalWrite(ledpin, HIGH);
    delay(2000);
    digitalWrite(ledpin, LOW);
    delay(2000);
}



// QUESTION: WAP for interfacing air quality sensor (MQ135) and display data generated by sensor on lcd/..

#include<LiquidCrystal.h>
LiquidCrystal lcd = (12, 11, 6, 5, 4, 3, 2);
int mqpin = A0;

void setup(){
    lcd.begin(16, 2);
}

void loop(){
    int reading=analogRead(mqpin);
    lcd.print(reading);
    delay(2000);
}



// QUESTION: WAP to control three led with three seprate button/..

int greenled = 2;
int redled = 3;
int blueled = 4;

int gbtn = 5;
int rbtn = 6;
int bbtn = 7;

void setup(){
    pinMode(greenled, OUTPUT);
    pinMode(redled, OUTPUT);
    pinMode(blueled, OUTPUT);

    pinMode(gbtn, INPUT);
    pinMode(rbtn, INPUT);
    pinMode(bbtn, INPUT);
}

void loop(){
    digitalWrite(greenled, digitalRead(gbtn));
    digitalWrite(redled, digitalRead(rbtn));
    digitalWrite(blueled, digitalRead(bbtn));
    delay(2000);
}


// QUESTION: WAP to control a motor through blutooth/..

int motor = 8;

void setup() {
  pinMode(motor, OUTPUT);
  Serial.begin(9600);
}

void loop() {
  if (Serial.available()) {
    char data = Serial.read();

    if (data == '1')
      digitalWrite(motor, HIGH);

    if (data == '0')
      digitalWrite(motor, LOW);
  }
}